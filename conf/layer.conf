## conf/layer.conf
```bitbake
# We have a conf and classes directory, add to BBPATH
BBPATH .= ":${LAYERDIR}"

# We have recipes-* directories, add to BBFILES
BBFILES += "${LAYERDIR}/recipes-*/*/*.bb \
	${LAYERDIR}/recipes-*/*/*.bbappend"

BBFILE_COLLECTIONS += "rpi-ssd1306"
BBFILE_PATTERN_rpi-ssd1306 = "^${LAYERDIR}/"
BBFILE_PRIORITY_rpi-ssd1306 = "11"

LAYERDEPENDS_rpi-ssd1306 = "raspberrypi"
```
